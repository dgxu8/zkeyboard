## boards/arm/leftmk_l1/Kconfig.board
```kconfig
config BOARD_LEFTMK_L1
	bool "STM32L151RCT6 Left Keyboard"
	depends on SOC_STM32L151XC
```

## boards/arm/leftmk_l1/leftmk_l1_defconfig
```kconfig
# enable uart driver
CONFIG_SERIAL=y
CONFIG_UART_STM32=y
CONFIG_UART_ASYNC_API=y

CONFIG_SOC_SERIES_STM32L1X=y
CONFIG_SOC_STM32L151XC=y

# enable GPIO
CONFIG_GPIO=y

# Enable Clocks, kconfigs exist for stm32 as well
CONFIG_CLOCK_CONTROL=y

# enable pin controller
CONFIG_PINCTRL=y

CONFIG_KSCAN=y
```

## drivers/kscan/Kconfig
```kconfig
config KSCAN_GPIO
	bool "GPIO based keyboard scan"
	default y
	depends on DT_HAS_GPIO_KSCAN_ENABLED
	select GPIO
	help
	  Enable GPIO KSCAN

config KSCAN_UART
	bool "UART com for keyboard scan"
	default y
	depends on DT_HAS_UART_KSCAN_ENABLED
	select SERIAL
	help
	  Enable UART KSCAN
```

## dts/bindings/kscan/zephyr,gpio-kscan.yaml
```yaml
description: |
  :placeholder:

  Example definition in devicetree:
    :placeholder:

compatible: "zephyr,gpio-kscan"

include: [base.yaml, pinctrl-device.yaml]

properties:
  pinctrl-0:
    required: true

  pinctrl-names:
    required: true

  col-gpios:
    type: phandle-array
    required: true
    description: Column GPIO to be driven

  row-gpios:
    type: phandle-array
    required: true
    description: Row GPIO to be read
```

## dts/bindings/kscan/zephyr,uart-kscan.yaml
```yaml
description: |
  :placeholder:

  Example definition in devicetree:
    :placeholder:

compatible: "zephyr,uart-kscan"

include: [base.yaml, pinctrl-device.yaml, uart-device.yaml]

properties:
  pinctrl-0:
    required: true

  pinctrl-names:
    required: true

  boot0-gpios:
    type: phandle-array
    required: true
    description: coproc boot0 gpio

  reset-gpios:
    required: true
    type: phandle-array
    description: coproc reset gpio
```
